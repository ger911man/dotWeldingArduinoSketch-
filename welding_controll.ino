// *********************************************
//
//  WELDING
//
// Generated by Gera 22.07.19/ Final v1.5
// *********************************************

#include <Arduino.h>

// Pinouts
#define PIN_WELDING_LED 13
// Potentiometer
#define PIN_POTENTIOMETER A0
// Button
#define PIN_WELDING_AUTOMATIC_BUTTON 3
#define PIN_WELDING_MANUAL_BUTTON 4
// Relays
#define PIN_WELDING_RELAY1 5
#define PIN_WELDING_RELAY2 6

// Constants
#define ONE_TICK_DELAY 50
#define MIN_AUTOMATIC_WELDING_TIME 50
#define MAX_AUTOMATIC_WELDING_TIME 2000
#define MAX_MANUAL_WELDING_TIME 10000

void setup()
{
    Serial.begin(115200);
    pinMode(PIN_WELDING_LED, OUTPUT);
    pinMode(PIN_POTENTIOMETER, INPUT);
    pinMode(PIN_WELDING_AUTOMATIC_BUTTON, INPUT);
    pinMode(PIN_WELDING_MANUAL_BUTTON, INPUT);
    pinMode(PIN_WELDING_RELAY1, OUTPUT);
    pinMode(PIN_WELDING_RELAY2, OUTPUT);
    digitalWrite(PIN_WELDING_RELAY1, HIGH);
    digitalWrite(PIN_WELDING_RELAY2, HIGH);
}

boolean isWeldingDone = true;
int potentiometerValue = 0;
int currentAutomaticButtonStatus = 0;
int prevAutomaticButtonStatus = 0;
int currentManualButtonStatus = 0;
int prevManualButtonStatus = 0;

int getWeldingTime(){
    potentiometerValue = analogRead(PIN_POTENTIOMETER);
    return map(potentiometerValue,0, 1023, 0, MAX_AUTOMATIC_WELDING_TIME) + MIN_AUTOMATIC_WELDING_TIME;
    // return potentiometerValue*(MAX_WELDING_TIME/1024) + MIN_AUTOMATIC_WELDING_TIME;
}

void startAutomaticWelding(){
    int weldingTime;
    weldingTime = getWeldingTime();
    Serial.print("Automatic welding ");
    Serial.println(weldingTime);
    digitalWrite(PIN_WELDING_LED, HIGH);
    digitalWrite(PIN_WELDING_RELAY1, LOW); //welding on
    digitalWrite(PIN_WELDING_RELAY2, LOW); //welding on
    delay(weldingTime);
    digitalWrite(PIN_WELDING_LED, LOW);
    digitalWrite(PIN_WELDING_RELAY1, HIGH); //welding off
    digitalWrite(PIN_WELDING_RELAY2, HIGH); //welding off
    isWeldingDone = true;
    Serial.println("Welding done");
}

void startManualWelding() {
    Serial.println("Manual welding");
    digitalWrite(PIN_WELDING_LED, HIGH);
    digitalWrite(PIN_WELDING_RELAY1, LOW); //welding on
    digitalWrite(PIN_WELDING_RELAY2, LOW); //welding on
    int manualWeldingCounter = 0;
    while(digitalRead(PIN_WELDING_MANUAL_BUTTON)){
        manualWeldingCounter += ONE_TICK_DELAY;
        if(manualWeldingCounter >= MAX_MANUAL_WELDING_TIME){
            digitalWrite(PIN_WELDING_LED, LOW);
            digitalWrite(PIN_WELDING_RELAY1, HIGH); //welding off
            digitalWrite(PIN_WELDING_RELAY2, HIGH); //welding off
            Serial.println("Manual welding stopped by timer");
        }
        delay(ONE_TICK_DELAY);
    }
    digitalWrite(PIN_WELDING_LED, LOW);
    digitalWrite(PIN_WELDING_RELAY1, HIGH); //welding off
    digitalWrite(PIN_WELDING_RELAY2, HIGH); //welding off
    Serial.println("Manual welding done");

}

void loop()
{
    currentAutomaticButtonStatus = digitalRead(PIN_WELDING_AUTOMATIC_BUTTON);
    if(currentAutomaticButtonStatus && prevAutomaticButtonStatus && !isWeldingDone){
        startAutomaticWelding();
    }
    if(!currentAutomaticButtonStatus && !prevAutomaticButtonStatus){
        isWeldingDone = false;
    }

    currentManualButtonStatus = digitalRead(PIN_WELDING_MANUAL_BUTTON);
    if(currentManualButtonStatus && prevManualButtonStatus){
        startManualWelding();
    }

    prevAutomaticButtonStatus = currentAutomaticButtonStatus;
    prevManualButtonStatus = currentManualButtonStatus;
    delay(ONE_TICK_DELAY);
}








